## conf/local.conf
```bitbake
MACHINE ??= 'imx6qsabresd'
DISTRO ?= 'poky'
PACKAGE_CLASSES ?= "package_rpm package_ipk"
EXTRA_IMAGE_FEATURES ?= "debug-tweaks ssh-server-openssh package-management"
USER_CLASSES ?= "buildstats image-mklibs"
PATCHRESOLVE = "noop"
BB_DISKMON_DIRS = "\
    STOPTASKS,${TMPDIR},1G,100K \
    STOPTASKS,${DL_DIR},1G,100K \
    STOPTASKS,${SSTATE_DIR},1G,100K \
    STOPTASKS,/tmp,100M,100K \
    ABORT,${TMPDIR},100M,1K \
    ABORT,${DL_DIR},100M,1K \
    ABORT,${SSTATE_DIR},100M,1K \
    ABORT,/tmp,10M,1K"
PACKAGECONFIG_append_pn-qemu-native = " sdl"
PACKAGECONFIG_append_pn-nativesdk-qemu = " sdl"
CONF_VERSION = "1"

LICENSE_FLAGS_WHITELIST= "commercial"
DL_DIR ?= "${BSPDIR}/downloads/"
ACCEPT_FSL_EULA = "1"
#PREFERRED_PROVIDER_virtual/bootloader= "u-boot-hio-imx6"

#IMAGE_FSTYPES += "tar.bz2"
IMAGE_INSTALL_append = " opkg ${TZ_DATA} ${HIO_ITEM} "

DISTRO_FEATURES_append = " opengl eg ttf-fonts pulseaudio"
DISTRO_FEATURES_remove = " x11 wayland "
PACKAGECONFIG_append_pn-qtmultimedia = " gstreamer gstreamer010"
PACKAGECONFIG_append_pn-qtwebkit = " gstreamer010 gstreamer"
PACKAGECONFIG_append_pn-qtbase = " sql-sqlite \
					gstreamer gstreamer010 \
				accessibility alsa \
				examples \
				gles2 \
				fontconfig \
				freetype \
				glib \
				tslib	\
				icu \
				openssl \
				"
PACKAGECONFIG_append_pn-qtwebengine = " ffmpeg libwebp opus vpx \
					libxslt speex "
CORE_IMAGE_MONO = " \
\
mono \
mono-helloworld \
"

#PREFERRED_VERSION_nodejs = "4.2.4"
#PREFERRED_VERSION_openssl = "1.0.2d"
NODE_JS = " \
nodejs \
nodejs-npm \
nodejs-systemtap \
"


#PREFERRED_VERSION_tzdata = "2015g"
TZ_DATA = " \
tzdata \
"
#ITEM_TOOKOUT = " cpuburn-neon libfslcodec libfslvpuwrap \
#	"

HIO_ITEM = " ffmpeg \
	smartpm iozone3 iperf fio lmbench memtester minicom sysstat nmon \
    	\
    	wpa-supplicant wireless-tools \
    	nano alsa-lib  alsa-tools \
    	curl fio openssh-sftp-server \
    	dhcp-client \
    	bluez-hcidump \
    	python-dbus python-pygobject \
    	dbus-glib dbus systemd-compat-units \
    	packagegroup-fsl-tools-testapps util-linux icu \
        freetype libcap libpcap gstreamer1.0-libav \
        gstreamer1.0-plugins-bad gstreamer1.0-plugins-base \
        gstreamer1.0-plugins-good gstreamer1.0-plugins-ugly \
        gstreamer1.0-plugins-imx fontconfig \	
	 pulseaudio-server hio-version hio-wifi gdbserver \
	 ppp  \
	tslib tslib-conf tslib-tests tslib-calibrate \
	iptables \
	wf111 \
	gdb \ 
"
IMAGE_INSTALL_append = " iozone3 iperf fio lmbench cpuburn-neon memtester minicom sysstat nmon "
#IMAGE_INSTALL_append = " "

IMAGE_INSTALL_append = " \
        hio-version hio-wifi hio-bass hio-rc-local hio-image alsa-state-rt5631 \
"

IMAGE_INSTALL_append = " gcc g++ binutils libgcc libgcc-dev libstdc++ libstdc++-dev libstdc++-staticdev \
automake ccache chkconfig glib-networking glibmm \
packagegroup-core-buildessential pkgconfig  \
fio \
dhcp-client \
\
python-dbus python-pygobject \
packagegroup-fsl-tools-testapps util-linux icu \
  freetype libcap libpcap gstreamer1.0-libav \
     gstreamer1.0-plugins-bad gstreamer1.0-plugins-base \
     gstreamer1.0-plugins-good gstreamer1.0-plugins-ugly \
      gstreamer1.0-plugins-imx fontconfig \	
pulseaudio-server hio-version hio-wifi gdbserver \
ppp  \
tslib \
tslib-conf \
tslib-tests \
tslib-calibrate \
boost cmake zlib glib-2.0 packagegroup-fsl-tools-testapps git \
   firmware-imx-vpu-imx6d \
   firmware-imx-vpu-imx6q \
   wpa-supplicant \
   wireless-tools \
   ruby \
   cpufrequtils \
   nano \
   gdb \
   tar \
   sqlite3 \
   gstreamer \
   gst-meta-video \
   \
   gst-plugins-base-app \
   gst-plugins-base \
   gst-plugins-good \
   gst-plugins-good-rtsp \
   gst-plugins-good-udp \
   gst-plugins-good-rtpmanager \
   gst-plugins-good-rtp \
   gst-plugins-good-video4linux2 \
   openssh-sftp-server \
   \
   packagegroup-fsl-tools-testapps \
   imx-vpu \
   imx-test \
   qtbase-fonts \
 \
   qtbase-tools \
\
   qtdeclarative \
   qtdeclarative-plugins \
   qtdeclarative-tools \
   qtdeclarative-qmlplugins \
\
   qtmultimedia \
   qtmultimedia-plugins \
   qtmultimedia-qmlplugins \
\
  qtsvg \
  qtsvg-plugins \
  qtsensors \
\
  qtimageformats \
  qtimageformats-plugins \
   \
\
qtsystems \
qtsystems-tools \
qtsystems-qmlplugins \
qtscript \
qt3d \
qt3d-qmlplugins \
qt3d-qmlplugins \
\
\
qtwebengine \
 \
 \
qtwebkit-qmlplugins \
qtgraphicaleffects \
qtxmlpatterns \
 \
qtgraphicaleffects-qmlplugins \
qtconnectivity-qmlplugins \
  qtlocation-plugins \
  qtlocation-qmlplugins \
  qtquick1 \
  qtquick1-qmlplugins \
  qtquick1-plugins \
  qtquickcontrols \
  \
 \
  qtwebchannel \
   \
  qtwebchannel-qmlplugins \
  qtwebengine \
  qtwebengine-qmlplugins \
  \
   \
  \
  cinematicexperience \
  cairo pango fontconfig freetype pulseaudio dbus \
  alsa-lib alsa-tools \
  i2c-tools \
  smartpm \
 \
  packagegroup-fonts-truetype-core \
  ttf-ubuntu-mono \
  ttf-ubuntu-sans \
  psplash \
  \
  acpid \
"
```
